## main/Kconfig.projbuild
```kconfig
menu "Artnet Configuration"

    config ESP_WIFI_SSID
        string "WiFi SSID"
        default "myssid"
        help
            SSID (network name) for the example to connect to.

    config ESP_WIFI_PASSWORD
        string "WiFi Password"
        default "mypassword"
        help
            WiFi password (WPA or WPA2) for the example to use.

    config ESP_MAXIMUM_RETRY
        int "Maximum retry"
        default 5
        help
            Set the Maximum retry to avoid station reconnecting to the AP unlimited when the AP is really inexistent.

    config ENABLE_IPV4
        bool "IPV4"
        default y

    config ENABLE_IPV6
        bool "IPV6"
        default n

    config ARTNET_PORT
        int "Port"
        range 0 65535
        default 6454
        help
            Local port the ArtNet node will listen on.

endmenu
```
